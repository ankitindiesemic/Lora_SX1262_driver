## build/Kconfig/Kconfig.shield
```kconfig
osource "d:/nrf52840_custom/boards/shields/*/Kconfig.shield"
osource "C:/ncs/v2.5.2/nrf/boards/shields/*/Kconfig.shield"
```

## build/Kconfig/Kconfig.shield.defconfig
```kconfig
osource "d:/nrf52840_custom/boards/shields/*/Kconfig.defconfig"
osource "C:/ncs/v2.5.2/nrf/boards/shields/*/Kconfig.defconfig"
```

## build/Kconfig/Kconfig.sysbuild.modules
```kconfig
menu "nrf (C:/ncs/v2.5.2/nrf)"
osource "C:/ncs/v2.5.2/nrf/sysbuild/Kconfig.sysbuild"
config ZEPHYR_NRF_MODULE
	bool
	default y
endmenu
```
